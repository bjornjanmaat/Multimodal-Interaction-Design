#include <SPI.h>

#define TFT_CS   10
#define TFT_DC    9
#define TFT_RST   8

// 16-bit 5-6-5 RGB Palette
#define COLOR_BG      0x0008 // Deep stage navy
#define COLOR_FLOOR   0x18C3 // Dark reflective floor
#define COLOR_CYAN    0x07FF
#define COLOR_MAGENTA 0xF81F
#define COLOR_YELLOW  0xFFE0
#define COLOR_GREEN   0x07E0
#define COLOR_RED     0xF800

void sendCommand(uint8_t cmd) {
  digitalWrite(TFT_DC, LOW);
  digitalWrite(TFT_CS, LOW);
  SPI.transfer(cmd);
  digitalWrite(TFT_CS, HIGH);
}

void sendData(uint8_t data) {
  digitalWrite(TFT_DC, HIGH);
  digitalWrite(TFT_CS, LOW);
  SPI.transfer(data);
  digitalWrite(TFT_CS, HIGH);
}

void setAddrWindow(uint8_t x0, uint8_t y0, uint8_t x1, uint8_t y1) {
  sendCommand(0x2A);
  sendData(0x00); sendData(x0);
  sendData(0x00); sendData(x1);

  sendCommand(0x2B);
  sendData(0x00); sendData(y0);
  sendData(0x00); sendData(y1);

  sendCommand(0x2C);
}

void fillRect(uint8_t x, uint8_t y, uint8_t w, uint8_t h, uint16_t color) {
  setAddrWindow(x, y, x + w - 1, y + h - 1);
  digitalWrite(TFT_DC, HIGH);
  digitalWrite(TFT_CS, LOW);
  uint8_t hi = color >> 8;
  uint8_t lo = color & 0xFF;
  for (uint16_t i = 0; i < (uint16_t)w * h; i++) {
    SPI.transfer(hi);
    SPI.transfer(lo);
  }
  digitalWrite(TFT_CS, HIGH);
}

#define DANCER_W 32
#define DANCER_H 60

// -------------------------------------------------------------
// Articulated 32x60 Dancer (Distinct biceps, elbows, forearms, hands)
// -------------------------------------------------------------
const uint8_t frame0[] PROGMEM = {
  // Pose 0: Right arm raised pointing diagonally up, left hand on hip
  0x00,0x07,0xE0,0x00, 0x00,0x0F,0xF0,0x03, 0x00,0x0F,0xF0,0x07, 0x00,0x1F,0xF8,0x0E,
  0x00,0x1F,0xF8,0x1C, 0x00,0x0F,0xF0,0x38, 0x00,0x07,0xE0,0x70, 0x00,0x03,0xC0,0xE0,
  0x00,0x03,0xC1,0xC0, 0x00,0x7F,0xFE,0x80, 0x01,0xFF,0xFF,0x00, 0x03,0xE7,0xFE,0x00,
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  0x00,0x00,0x00,0x00, 0x00,0x00,0x00,0x00, 0x00,0x00,0x00,0x00, 0x00,0x00,0x00,0x00
};

const uint8_t frame1[] PROGMEM = {
  // Pose 1: Dip / Groove crouch, elbows out wide at 90 deg, forearms in front
  0x00,0x00,0x00,0x00, 0x00,0x00,0x00,0x00, 0x00,0x00,0x00,0x00, 0x00,0x07,0xE0,0x00,
  0x00,0x0F,0xF0,0x00, 0x00,0x1F,0xF8,0x00, 0x00,0x1F,0xF8,0x00, 0x00,0x0F,0xF0,0x00,
  0x00,0x07,0xE0,0x00, 0x00,0x03,0xC0,0x00, 0x00,0x03,0xC0,0x00, 0x00,0x7F,0xFE,0x00,
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  0x00,0x00,0x00,0x00, 0x00,0x00,0x00,0x00, 0x00,0x00,0x00,0x00, 0x00,0x00,0x00,0x00
};

const uint8_t frame2[] PROGMEM = {
  // Pose 2: Mirror pop—left arm reaching high, right hand hooked at hip
  0x00,0x07,0xE0,0x00, 0xC0,0x0F,0xF0,0x00, 0xE0,0x0F,0xF0,0x00, 0x70,0x1F,0xF8,0x00,
  0x38,0x1F,0xF8,0x00, 0x1C,0x0F,0xF0,0x00, 0x0E,0x07,0xE0,0x00, 0x07,0x03,0xC0,0x00,
  0x03,0x83,0xC0,0x00, 0x01,0x7F,0xFE,0x00, 0x00,0xFF,0xFF,0x80, 0x00,0x7F,0xE7,0xC0,
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  0x00,0x00,0x00,0x00, 0x00,0x00,0x00,0x00, 0x00,0x00,0x00,0x00, 0x00,0x00,0x00,0x00
};

const uint8_t frame3[] PROGMEM = {
  // Pose 3: The Pump / Victory pump, both elbows bent sharply, hands up at ear level
  0x0E,0x07,0xE0,0x70, 0x1F,0x0F,0xF0,0xF8, 0x1F,0x0F,0xF0,0xF8, 0x1B,0x1F,0xF8,0xD8,
  0x1B,0x1F,0xF8,0xD8, 0x18,0x0F,0xF0,0x18, 0x18,0x07,0xE0,0x18, 0x1C,0x03,0xC0,0x38,
  0x1C,0x03,0xC0,0x38, 0x0E,0x7F,0xFE,0x70, 0x0F,0xFF,0xFF,0xF0, 0x07,0xDF,0xFB,0xE0,
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  0x00,0x00,0x00,0x00, 0x00,0x00,0x00,0x00, 0x00,0x00,0x00,0x00, 0x00,0x00,0x00,0x00
};

const uint8_t* const danceFrames[4] = { frame0, frame1, frame2, frame3 };
const uint16_t dancerColors[4] = { COLOR_CYAN, COLOR_MAGENTA, COLOR_GREEN, COLOR_YELLOW };

void drawSilhouette(uint8_t x, uint8_t y, const uint8_t *bitmap, uint16_t fgColor, uint16_t bgColor) {
  setAddrWindow(x, y, x + DANCER_W - 1, y + DANCER_H - 1);
  digitalWrite(TFT_DC, HIGH);
  digitalWrite(TFT_CS, LOW);

  uint8_t fgHi = fgColor >> 8, fgLo = fgColor & 0xFF;
  uint8_t bgHi = bgColor >> 8, bgLo = bgColor & 0xFF;

  for (uint8_t row = 0; row < DANCER_H; row++) {
    for (uint8_t byteIdx = 0; byteIdx < (DANCER_W / 8); byteIdx++) {
      uint8_t b = pgm_read_byte(&bitmap[row * (DANCER_W / 8) + byteIdx]);
      for (int8_t bit = 7; bit >= 0; bit--) {
        if (b & (1 << bit)) {
          SPI.transfer(fgHi);
          SPI.transfer(fgLo);
        } else {
          SPI.transfer(bgHi);
          SPI.transfer(bgLo);
        }
      }
    }
  }
  digitalWrite(TFT_CS, HIGH);
}

void initST7735() {
  pinMode(TFT_CS, OUTPUT);
  pinMode(TFT_DC, OUTPUT);
  pinMode(TFT_RST, OUTPUT);

  SPI.begin();
  SPI.setClockDivider(SPI_CLOCK_DIV4);

  digitalWrite(TFT_RST, HIGH);
  delay(10);
  digitalWrite(TFT_RST, LOW);
  delay(10);
  digitalWrite(TFT_RST, HIGH);
  delay(120);

  sendCommand(0x11);
  delay(120);
  sendCommand(0x3A);
  sendData(0x05);
  sendCommand(0x29);
  delay(20);
}

void updateStageLights(uint8_t step) {
  const uint16_t laserColors[4] = { COLOR_RED, COLOR_CYAN, COLOR_YELLOW, COLOR_MAGENTA };
  for (uint8_t i = 0; i < 4; i++) {
    uint16_t c = laserColors[(i + step) % 4];
    fillRect(10 + i * 28, 2, 22, 4, c);
  }

  for (uint8_t j = 0; j < 6; j++) {
    uint16_t dotCol = ((j + step) % 2 == 0) ? COLOR_CYAN : COLOR_MAGENTA;
    fillRect(8 + j * 20, 94, 12, 3, dotCol);
  }

  uint16_t spotGlow = ((step % 2) == 0) ? 0x2174 : 0x410C;
  fillRect(36, 99, 56, 8, spotGlow);
}

void setup() {
  initST7735();

  fillRect(0, 0, 128, 94, COLOR_BG);
  fillRect(0, 94, 128, 3, COLOR_MAGENTA);
  fillRect(0, 97, 128, 31, COLOR_FLOOR);
}

uint8_t currentFrame = 0;
const uint8_t dancerX = 48;
const uint8_t dancerY = 36;

void loop() {
  updateStageLights(currentFrame);
  drawSilhouette(dancerX, dancerY, danceFrames[currentFrame], dancerColors[currentFrame], COLOR_BG);

  delay(170);
  currentFrame = (currentFrame + 1) % 4;
}
